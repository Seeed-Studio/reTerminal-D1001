## driver_examples/01_I2SCodec/main/Kconfig.projbuild
```kconfig
menu "Example Configuration"

    config EXAMPLE_VOICE_VOLUME
        int "Voice volume"
        range 0 100
        default 60
        help
            Set voice volume
endmenu
```
